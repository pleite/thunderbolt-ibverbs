## kernel/Kconfig
```kconfig
# SPDX-License-Identifier: GPL-2.0

config THUNDERBOLT_IBVERBS
	tristate "Thunderbolt/USB4 host-to-host RDMA verbs"
	depends on CONFIGFS_FS && INFINIBAND && THUNDERBOLT
	help
	  Expose Thunderbolt/USB4 host-to-host DMA paths as an RDMA verbs
	  device. The driver has separate native Linux and Apple-compatible
	  protocol backends.

	  This tree is the release-track rewrite. Experimental hardware
	  probing and debug-only modes should stay out of this driver.

config THUNDERBOLT_IBVERBS_DEBUG_SURFACES
	bool "Enable thunderbolt-ibverbs debugfs/configfs surfaces"
	depends on THUNDERBOLT_IBVERBS
	default y
	help
	  Build the debugfs and configfs control/diagnostic surfaces.
	  Disable this for production builds that must compile these
	  interfaces out entirely.

config TBV_GPU_DIRECT
	bool "Enable thunderbolt-ibverbs GPU-direct (dma-buf) memory regions"
	depends on THUNDERBOLT_IBVERBS && DMA_SHARED_BUFFER
	default n
	help
	  Compile in the gated reg_user_mr_dmabuf verb so that GPU buffers
	  exported as dma-buf file descriptors (for example ROCm allocations
	  on unified-memory APUs) can be registered as RDMA memory regions.

	  This is the build-time half of the GPU-direct optionality controls
	  described in docs/gpu-direct-plan.md. When disabled (the default),
	  ibv_reg_dmabuf_mr() returns EOPNOTSUPP and behavior is identical to
	  the host-copy-only releases. Activation is additionally gated at load
	  time by the gpu_direct=auto|on|off module parameter.
```
